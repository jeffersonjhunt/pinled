## main/Kconfig.projbuild
```kconfig
menu "pinled configuration"

    menu "GPIO assignment (ESP32-S3 defaults)"
        config PINLED_CLK_GPIO
            int "74x165 CLK GPIO (bussed to every module)"
            default 18
            help
                A0 on the QT Py ESP32-S3; IO18 on the S3-DevKitC-1.

                Driven as SPI SCLK. Daisy this along the harness rather than
                star-wiring it (HW-14): the skew then arrives in the direction
                that ADDS to hold margin instead of eating it.
        config PINLED_PL_GPIO
            int "/PL parallel-load GPIO (-1 = not fitted)"
            default 17
            range -1 48
            help
                A1 on the QT Py ESP32-S3; IO17 on the S3-DevKitC-1.

                /PL is bussed to every '165 and is LEVEL-sensitive, not edge:
                while low the registers are transparent and continuously load
                their inputs; the rising edge freezes the whole chain, which is
                what makes every channel share one capture instant. It is pin 5
                of the 5-pin harness. See docs/CHAINING.md.
        config PINLED_DATA_GPIO
            int "DATA_IN GPIO (serial stream off the head of the chain)"
            default 9
            help
                A2 on the QT Py ESP32-S3; IO9 on the S3-DevKitC-1.

                Read as SPI MISO. This is NOT a bus: it is the QH output of the
                first module's U1, one push-pull driver point-to-point, with a
                10k pull-down so an absent or unpowered chain reads a clean zero
                (HW-11). Chaining costs no additional GPIO.
        config PINLED_LED_GPIO
            int "WS2812B/SK6812 data GPIO (RMT)"
            default 8
            help
                A3 on the QT Py ESP32-S3; IO8 on the S3-DevKitC-1.

        config PINLED_STATUS_GPIO
            int "Status pixel data GPIO (-1 = not fitted)"
            default 39
            range -1 48
            help
                The QT Py ESP32-S3's onboard NeoPixel. On the mainboard this is
                a WS2812-class part of its own (HW-15).

                Its own GPIO, and never the first pixel of the playfield string
                (FR-IND-1): the string is the product and is routed out to the
                playfield, whereas this has to be readable at the board.

                -1 disables the indicator entirely. Everything else still runs
                -- the pixel is feedback, not function.
        config PINLED_STATUS_POWER_GPIO
            int "Status pixel power-enable GPIO (-1 = always powered)"
            default 38
            range -1 48
            help
                The QT Py gates power to its onboard pixel and it is dark
                without this driven high, which looks exactly like a dead
                driver. Set -1 where the pixel is permanently powered.
        config PINLED_STATUS_BRIGHTNESS
            int "Status pixel brightness (0-255, 0 = off)"
            default 64
            range 0 255
            help
                The build default. FR-IND-5 makes this a stored setting, so a
                configured install overrides it; this is what an unprovisioned
                board and a board running on defaults show.

                Low on purpose: the board may sit in a backbox and the
                indicator must never compete with the playfield.

        # Note: the POC defaults (25/27/26/15) are unusable here. GPIO 26 and 27
        # are SPI flash pins on the ESP32-S3, and 15 and 25 are not broken out
        # on this board.
    endmenu

    menu "Scan geometry"
        config PINLED_NUM_MODULES
            int "Number of 16-channel modules on the bus"
            range 1 8
            default 1
        config PINLED_CHANNELS_PER_MODULE
            int "Channels per module (8 = one '165, 16 = two)"
            range 8 16
            default 16
        config PINLED_ACTIVE_LOW
            bool "Front end is active-low (inverting)"
            default n
            help
                The v2 front end is a level-shift MOSFET (inverting) followed by
                an inverting Schmitt trigger, so it is non-inverting overall:
                lamp on reads as logic high. Leave this off for v2 hardware.

                This must stay consistent with the orientation of the DATA_IN
                bias resistor: a floating or unpopulated bus has to read "lamp
                off", which for a non-inverting front end means a pull-down.
                lamp_scan also derives the MCU's internal pull on DATA_IN from
                this setting, so all three flip together.
                See docs/TIMING.md section 4.2.
    endmenu

    menu "Chain clock (SPI)"
        config PINLED_SPI_HZ
            int "Chain clock rate (Hz)"
            default 4000000
            range 100000 40000000
            help
                SCLK rate for the scan burst. A frame is 16*N bits plus ~17 us
                of fixed per-transaction overhead (measured, docs/TIMING.md
                section 2.4), so the burst is the smaller half of the cost.

                4 MHz rather than 2 because at 2 MHz a 128-channel frame is
                81 us, which the boot check clamps below the 10 kHz target; at
                4 MHz it is 49 us and fits.

                Raising this shortens the frame; lowering it is the first thing
                to try if far modules read wrong while near ones are fine, since
                multi-drop CLK integrity is the rev D binding constraint
                (docs/TIMING.md section 4.3). On breadboarded 74HC165 parts at
                3.3 V, 4 MHz was measured clean on a 4-chip breadboard rig for
                millions of frames (2026-08-06/07), and HW-3 was relaxed from
                2 MHz to 4 MHz to match. That ceiling is about the device; what
                limits a long chain is multi-drop CLK integrity across 800 mm,
                governed separately by HW-14 and TIMING.md section 4.3.

                The range now allows up to 40 MHz, which is the ESP32-S3's
                ceiling through the GPIO matrix -- SCLK and MISO are routed
                through it here, neither being an IOMUX SPI pin. That is a
                bound on what you may ASK for, not a qualified rate. On
                SN74LVC165 parts the 2026-08-14 sweep matched its reference at
                every rate to 40 MHz, but with a SPARSE bus pattern; see
                BRINGUP.md section 4b before believing it.

                Raising the clock also buys less than it looks like, because
                the driver's fixed ~19 us per transaction dominates. At 32
                channels a 4 MHz burst is 8 us of a 26.8 us frame, so even
                40 MHz saves 7 us of 27. It matters at 128 channels, where the
                burst is 32 us at 4 MHz and 6 us at 20 MHz: a 51 us frame
                becomes 25 us and the 10 kHz duty halves. Past ~20 MHz the
                overhead dominates again, so that is where the curve flattens
                and the margin is still large.

        config PINLED_SPI_MODE
            int "SPI mode (0..3)"
            default 2
            range 0 3
            help
                Leave this at 2 for rev D hardware.

                A '165 shifts QH on the RISING clock edge, and after /PL rises
                QH already presents channel 0 with no clock at all. Mode 2
                (CPOL=1, CPHA=0) idles the clock high and samples on the falling
                edge, which lands mid bit-cell -- half a period after the shift
                that produced the bit and half a period before the next.

                Mode 3 samples on the same rising edge the '165 shifts on, so
                the whole frame slides by one channel and channel 0 becomes
                unreachable. That clean off-by-one is the signature.

                MEASURED 2026-08-06 on a 4x 74HC165 rig at 4 MHz: U1.D read as
                channel 4 and U2.D as channel 12, exactly. This is no longer an
                assumption -- if every channel reads its neighbour, suspect the
                wiring or the clock rate, not the mode.

        config PINLED_PL_FROM_CS
            bool "Drive /PL from the SPI CS line"
            default y
            help
                Wires /PL to the SPI peripheral's chip-select with positive
                polarity, so it is LOW between transactions (registers
                transparent, tracking their inputs) and HIGH during one
                (frozen, shifting). The capture instant becomes hardware-timed
                and cannot be forgotten or mistimed.

                Turn off to drive /PL as a plain GPIO, pulsed low then high
                before each frame -- useful on a rig where CS is not routed to
                the load pin. The GPIO path costs two extra register writes per
                frame and puts the capture instant back under software timing.
    endmenu

    menu "Timing"
        config PINLED_SAMPLE_RATE_HZ
            int "Per-channel raw sample rate (Hz)"
            default 10000
            help
                Target rate, paced by a hardware timer so dt is uniform --
                which is what the filament integrator assumes.

                This is a request, not a promise: at boot the driver measures
                what the scan hardware actually sustains and clamps to 60% of
                the free-run ceiling. The clamped value is what every time
                constant is derived from. See docs/TIMING.md section 2.6.
        config PINLED_REFRESH_HZ
            int "LED frame rate (Hz)"
            range 30 240
            default 90

    endmenu

    menu "Auto-profiler"
        config PINLED_PROFILE_WINDOW_MS
            int "Observation window (ms)"
            range 50 5000
            default 750
            help
                How long the classifier watches before deciding what each
                channel is (FR-PROF-5). Milliseconds, not frames: every
                pattern it looks for is a wall-clock one -- a 60 Hz mains
                half-cycle is 8.3 ms and a matrix strobe is under 5 -- so the
                frame count is derived from the MEASURED sample rate.

                750 ms is about ninety mains half-cycles, which is enough to
                separate a dimmed GI from a steady one. Shorter is not cheaper
                in any way that matters: the pass runs once at boot and
                whenever it is re-armed, never continuously.

        config PINLED_PROFILE_REARM_BUTTON
            bool "Re-arm the profiler on a short button press"
            default y
            depends on PINLED_RESCUE_GPIO >= 0
            help
                A SHORT press of the rescue button re-runs the classifier on a
                running machine (FR-PROF-2). Boot classification sees a dark
                playfield and calls every channel OFF, so the pass that
                matters is the one run with the game turned on.

                One pin, one task, two jobs split by duration: a short press
                profiles, a long hold erases the network. There is no separate
                GPIO option because a second task polling the same pin would
                be a second answer to "was it pressed".

                Turning this off leaves the short press logged and ignored;
                POST /api/v1/profiler still works.
    endmenu

    menu "Filament model defaults"
        config PINLED_ATTACK_MS
            int "Filament attack time constant (ms)"
            default 30
        config PINLED_DECAY_MS
            int "Filament decay time constant (ms)"
            default 40
    endmenu

    menu "LED string"
        config PINLED_LED_COUNT
            int "Number of addressable LEDs"
            default 16

        config PINLED_STARTUP_WALK
            bool "Walk the LED string at startup"
            default y
            help
                At boot, light one LED at a time from 0 upwards, so you can see
                that every pixel is present, wired the right way round, and
                reachable.

                A WS2812 string is a shift register in disguise: one dead pixel
                or one cold joint kills everything downstream of it. Without
                this the symptom is "the far half of my playfield does
                nothing", which looks like a configuration fault and is not
                one -- and which you would otherwise only discover after
                wiring and mapping the whole machine.

                Turn off once a machine is commissioned and you would rather
                have the boot time back.

        config PINLED_STARTUP_WALK_MS
            int "Startup walk: ms per LED"
            depends on PINLED_STARTUP_WALK
            default 10
            range 1 1000
            help
                At boot, light one LED at a time from 0 upwards, so you can see
                that every pixel is present, wired the right way round, and
                reachable.

                A WS2812 string is a shift register in disguise: one dead pixel
                or one cold joint kills everything downstream of it. Without
                this the symptom is "the far half of my playfield does
                nothing", which looks like a configuration fault and is not
                one -- and which you would otherwise only discover after
                wiring and mapping the whole machine.

                One pixel at a time rather than a cumulative fill: a full
                string of white is about 60 mA a pixel, which is 7.7 A at the
                128-LED maximum and would brown out most bench supplies. A
                single dot is 60 mA however long the string is.

                COSTS BOOT TIME: led_count x this. At 10 ms a 16-LED string is
                160 ms and a full 128 is 1.3 s -- fast enough to read as a
                sweep rather than a wait, and still slow enough to see a gap.
    endmenu

    menu "Networking"
        config PINLED_RESCUE_GPIO
            int "Rescue button GPIO (-1 = disabled)"
            default 0
            range -1 48
            help
                Held down on a RUNNING device, this erases the stored network
                and restarts into the SoftAP (FR-UI-7) -- the way back in when
                a router has been replaced and the controller is joining
                nothing.

                GPIO 0 is the BOOT button on both the QT Py and the DevKitC.
                Note this is NOT the same as holding BOOT while resetting,
                which puts the chip in ROM download mode before any firmware
                runs.

                HARDWARE.md also gives this pin to the profiler re-arm, so the
                two are split by duration: a short press is reserved for that,
                a long hold does this.

        config PINLED_RESCUE_HOLD_MS
            int "Rescue button hold (ms)"
            default 5000
            range 1000 30000
            help
                Long enough that nobody does it by accident while handling the
                board, short enough that nobody gives up first.

        config PINLED_HOSTNAME
            string "mDNS hostname"
            default "pinled"
            help
                Advertised as <name>.local, which is what makes
                `pbtool.py get http://pinled.local/api/v1/config` work without
                hunting for a DHCP lease.

                Two boards on one network with the same name will collide;
                mDNS resolves that by renaming one, so check the boot log for
                the name actually claimed.

        config PINLED_LED_LOAD_TEST
            bool "Measure string current at boot (bring-up only)"
            default n
            help
                Holds the WHOLE string at white, stepping 25/50/75/100% with
                ten seconds at each level and a log line announcing the step,
                so a meter in series with the string yields a curve rather
                than a single number.

                Exists because the 60 mA/LED in HARDWARE.md was a datasheet
                worst case that nobody had measured, and the bench says
                otherwise. A power budget is worth measuring once.

                WARNING: this is the highest current the string can draw, and
                it lasts 40 seconds. Check your supply against
                led_count x (whatever you measure at 100%) before enabling it
                on a long string. Leave it off otherwise -- it delays boot and
                blinds anyone looking at the playfield.
    endmenu

    menu "Configuration store"
        config PINLED_STORE_SELFTEST
            bool "Exercise the document store at boot (bring-up aid)"
            default n
            help
                Writes a small document to the filesystem, reads it back, and
                reports whether the bytes and the CRC survived -- then removes
                it. Runs before any configuration is loaded, so it cannot
                disturb a real one.

                This exists because the atomic-write path is the one part of
                the store that host tests can only approximate. On the host
                rename() is POSIX; on the device it is LittleFS's, on real
                flash, through the VFS layer. Those are the bytes that have to
                survive a power cut, so they get exercised on the actual
                medium at least once.

                Leave this off in normal operation. It is a diagnostic, not a
                check the firmware needs at every boot.

        config PINLED_SEED_FS
            bool "Flash the fs_seed documents into the storage partition"
            default n
            help
                Builds fs_seed/ into a LittleFS image and flashes it alongside
                the app, so the board boots with an install config and a
                machine profile already present.

                This is how the READ path gets verified on hardware: the
                documents are authored on the host with tools/pbtool.py,
                exactly as the web UI will author them, and the device only
                reads them. Host tests cannot cover that seam -- it is where
                the C, nanopb and Google's protobuf have to agree about the
                same bytes on the same flash.

                DESTRUCTIVE while it is on: every `idf.py flash` overwrites
                whatever configuration the device had. Turn it off again once
                you have what you need. With it off, flashing the app leaves
                the storage partition untouched, which is the normal and
                intended behaviour.
    endmenu

    menu "Diagnostics"
        config PINLED_SCAN_DEBUG
            bool "Log raw scan frames (bring-up aid)"
            default y
            help
                Prints the raw pre-filament channel bitmap twice a second, plus
                a per-channel flag showing whether that channel has ever been
                observed both high and low since boot.

                Use this to prove the scan bus is alive independently of the
                filament model and the LED string: press a test input and watch
                the corresponding bit move. A channel that never toggles is
                unconnected, unpopulated, or pinned by the chain terminator.

                Bits are grouped in eights, and each group is one '165: the
                first is U1 (ch 0..7), the second U2 (ch 8..15), and so on down
                the chain.

                Turn off for production -- it costs an array write per channel
                per frame inside the scan loop.

        config PINLED_SCAN_STEP_MS
            int "Slow-step the scan (ms per channel, 0 = normal speed)"
            default 0
            range 0 2000
            help
                Bring-up only. At normal speed CLK toggles in the megahertz, so
                indicator LEDs on the chain signals sit at a steady half
                brightness -- which reads as "not running" and sends you hunting
                a fault that is not there.

                Set this to e.g. 250 and the scan advances one bit every 250 ms,
                logging the bit index, the module / '165 / input pin it came
                from, and the DATA level read. Unlike rev C there is no counter
                to watch on a scope: DATA is the only observable, which is why
                the log names the pin.

                The walk re-asserts /PL and re-advances before every step
                (FR-DIAG-2) rather than walking one frozen snapshot, so an input
                toggled part-way through is still visible.

                While non-zero, scan_task is NOT started -- the walk owns the
                chain -- so the filament model and the LED string do not update.
                Set back to 0 for normal operation.

        config PINLED_SPI_SWEEP
            bool "Sweep the chain clock and report where it breaks"
            default n
            help
                Bring-up only. Steps the SPI clock through a fixed ladder and,
                at each rate, reads a burst of frames and reports how many were
                identical plus the union of every bit seen.

                Hold one test input down and let it run: a rate is good when the
                burst is 100% stable and the union shows only that one channel.
                Instability or extra bits in the union is the ceiling.

                This is TIMING.md section 7 item 3 -- the clock-skew estimate is
                datasheet arithmetic and wants measuring. Suppresses scan_task,
                so the LEDs do not update.

        config PINLED_SCAN_HOLD_CH
            int "Park the chain on one channel (-1 = disabled)"
            default -1
            range -1 127
            help
                Bring-up only, and takes precedence over the slow-step walk.

                Snapshots the chain, clocks exactly k times, then stops and
                never clocks again, sampling DATA at 2 Hz. DATA becomes a static
                DC level you can measure with an ordinary meter:

                  - front-end output at the '165 input pin -> your input,
                    follow it with the button
                  - U1 QH (pin 9)  -> equal to that input, for the parked channel
                  - after R2 (33R) -> the same
                  - the MCU DATA pin -> the same

                Whichever link stops tracking is the fault. On a chained rig,
                park on a channel in the FAR module: if near modules track and
                far ones do not, the fault is the QH -> SER handoff between them.

                Channel 0 is special-cased to hold /PL LOW instead of clocking
                (FR-DIAG-3). The registers then stay transparent and DATA tracks
                channel 0 LIVE, so you can watch a meter move as you press the
                button -- rev C had no equivalent.

                Set back to -1 for normal operation.
    endmenu

endmenu
```
